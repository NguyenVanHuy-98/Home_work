AUTOSAR XML (schema 4-2-2)
package /ServiceInterfaces
  service interface TemperatureSensor
    events:
      data TemperatureUpdate: type=float
    methods:
      operation GetCurrentTemperature
        arg result: type=float, direction=OUT
